#include <string.h>
#include "freertos/FreeRTOS.h"
#include "freertos/task.h"
#include "driver/gpio.h"
#include "esp_log.h"
#include "src/display/epaper_driver_bsp.h"
#include "src/power/board_power_bsp.h"

#define EPD_WIDTH   200
#define EPD_HEIGHT  200

#define EPD_DC_PIN    GPIO_NUM_10
#define EPD_CS_PIN    GPIO_NUM_11
#define EPD_SCK_PIN   GPIO_NUM_12
#define EPD_MOSI_PIN  GPIO_NUM_13
#define EPD_RST_PIN   GPIO_NUM_9
#define EPD_BUSY_PIN  GPIO_NUM_8
#define EPD_SPI_NUM   SPI2_HOST

#define EPD_PWR_PIN   GPIO_NUM_6
#define AUDIO_PWR_PIN GPIO_NUM_42
#define VBAT_PWR_PIN  GPIO_NUM_17

static const char *TAG = "hello_world";

epaper_driver_display *driver = NULL;
board_power_bsp_t board_power(EPD_PWR_PIN, AUDIO_PWR_PIN, VBAT_PWR_PIN);

static const uint8_t font5x7[96][7] = {
    {0x00,0x00,0x00,0x00,0x00,0x00,0x00},
    {0x04,0x04,0x04,0x04,0x04,0x00,0x04},
    {0x0A,0x0A,0x0A,0x00,0x00,0x00,0x00},
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    {0x08,0x15,0x02,0x00,0x00,0x00,0x00}
};

void drawString(int x, int y, const char *str, uint8_t scale, uint8_t color) {
    while (*str) {
        char c = *str++;
        if (c < 0x20 || c > 0x7E) {
            c = '?';
        }
        const uint8_t *glyph = font5x7[c - 0x20];
        for (int row = 0; row < 7; row++) {
            for (int col = 0; col < 5; col++) {
                if (glyph[row] & (0x10 >> col)) {
                    for (int dy = 0; dy < scale; dy++) {
                        for (int dx = 0; dx < scale; dx++) {
                            driver->EPD_DrawColorPixel(x + col * scale + dx, y + row * scale + dy, color);
                        }
                    }
                }
            }
        }
        x += 6 * scale;
    }
}

void setup() {
    Serial.begin(115200);
    board_power.POWEER_EPD_ON();
    board_power.POWEER_Audio_ON();

    custom_lcd_spi_t driver_config = {};
    driver_config.cs = EPD_CS_PIN;
    driver_config.dc = EPD_DC_PIN;
    driver_config.rst = EPD_RST_PIN;
    driver_config.busy = EPD_BUSY_PIN;
    driver_config.mosi = EPD_MOSI_PIN;
    driver_config.scl = EPD_SCK_PIN;
    driver_config.spi_host = EPD_SPI_NUM;
    driver_config.buffer_len = EPD_WIDTH * EPD_HEIGHT / 8;

    driver = new epaper_driver_display(EPD_WIDTH, EPD_HEIGHT, driver_config);
    driver->EPD_Init();
    driver->EPD_Clear();

    const char *text = "Hello World";
    int len = strlen(text);
    int scale = 3;
    int textW = len * 6 * scale - 1 * scale;
    int x = (EPD_WIDTH - textW) / 2;
    int y = (EPD_HEIGHT - 7 * scale) / 2;

    drawString(x, y, text, scale, DRIVER_COLOR_BLACK);
    driver->EPD_Display();

    ESP_LOGI(TAG, "Hello World drawn on e-Paper");
}

void loop() {
    delay(1000);
}
